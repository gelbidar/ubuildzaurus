## br2-external/package/gpe-edit/Config.in
```kconfig
config BR2_PACKAGE_GPE_EDIT
	bool "gpe-edit"
	depends on BR2_PACKAGE_LIBGTK2
	select BR2_PACKAGE_LIBGPEWIDGET
	help
	  GPE Editor - a small GTK2 plain-text editor built for PDA screens:
	  toolbar-driven, single window, find/replace, and a file selector
	  sized for a stylus rather than a mouse.

	  http://gpe.linuxtogo.org/ (defunct; sourced from the Debian archive)
```

## br2-external/package/gpe-icons/Config.in
```kconfig
config BR2_PACKAGE_GPE_ICONS
	bool "gpe-icons"
	help
	  The shared GPE icon set (/usr/share/gpe/pixmaps/default).

	  This is data only - no code - but it is not optional for the GPE
	  apps: they all call gpe_load_icons() with a table of bare icon
	  names ("save_as", "cut", "dir-up", ...) which libgpewidget resolves
	  against this directory, and every one of them aborts at startup if
	  a single icon is missing.

	  http://gpe.linuxtogo.org/ (defunct; sourced from the Debian archive)
```

## br2-external/package/gpe-sketchbook/Config.in
```kconfig
config BR2_PACKAGE_GPE_SKETCHBOOK
	bool "gpe-sketchbook"
	depends on BR2_PACKAGE_LIBGTK2
	select BR2_PACKAGE_LIBGPEWIDGET
	select BR2_PACKAGE_SQLITE2
	# gdk-pixbuf comes in with libgtk2
	help
	  GPE Sketchbook - a stylus-oriented freehand drawing pad. Sketches
	  are kept in a sqlite-indexed notebook (~/.gpe/sketchbook) with a
	  thumbnail selector, and saved as PNG.

	  Probably the most obviously touchscreen-native app in GPE, and the
	  one the Zaurus' stylus is actually good at.

	  Note this links SQLite *2* (see the sqlite2 package), not SQLite 3.

	  http://gpe.linuxtogo.org/ (defunct; recovered from the Internet
	  Archive's copy of the upstream download directory)
```

## br2-external/package/gpe-todo/Config.in
```kconfig
config BR2_PACKAGE_GPE_TODO
	bool "gpe-todo"
	depends on BR2_PACKAGE_LIBGTK2
	select BR2_PACKAGE_LIBGPEWIDGET
	select BR2_PACKAGE_LIBTODODB
	select BR2_PACKAGE_LIBGPEPIMC
	help
	  GPE To-Do List - the PIM task manager: categorised to-do items with
	  due dates, priorities and completion state, stored in the shared
	  GPE sqlite database (~/.gpe/todo.db) via libtododb.

	  http://gpe.linuxtogo.org/ (defunct; sourced from the Debian archive)
```

## br2-external/package/gqmpeg/Config.in
```kconfig
config BR2_PACKAGE_GQMPEG
	bool "gqmpeg"
	depends on BR2_PACKAGE_LIBGTK2
	select BR2_PACKAGE_MPG123
	select BR2_PACKAGE_LIBPNG
	help
	  GQmpeg 0.91.1 - a GTK2 graphical frontend/skinnable player that
	  spawns and remote-controls the mpg123 binary for actual decode
	  (confirmed: no libmpg123 linkage, just execvp("mpg123", ...) at
	  runtime - genuinely just a GUI wrapper, matches how it's used
	  here). Also has io_ modules for ogg123/xmp/internet radio if
	  those player binaries happen to be present, but mpg123 is the
	  only one this project actually installs.

	  Real 2004 release, GTK+ 2.2.0+ (we have 2.24.33) - no GTK1/GTK3
	  toolkit needed. Needed 3 small cross-compile fixes (see the two
	  0*.patch files here) verified by an actual standalone
	  cross-compile through to a linked ARM binary before packaging.

	  https://gqmpeg.sourceforge.net/
```

## br2-external/package/libgpepimc/Config.in
```kconfig
config BR2_PACKAGE_LIBGPEPIMC
	bool "libgpepimc"
	depends on BR2_PACKAGE_LIBGTK2
	select BR2_PACKAGE_LIBGPEWIDGET
	select BR2_PACKAGE_SQLITE2
	help
	  Shared "PIM categories" library for the GPE Palmtop Environment:
	  the category table in the shared sqlite database plus the category
	  selection/edit dialogs the PIM apps embed.

	  Required by libtododb, and therefore by gpe-todo.

	  Note this links SQLite *2* (see the sqlite2 package), not SQLite 3.

	  http://gpe.linuxtogo.org/ (defunct; sourced from the Debian archive)
```

## br2-external/package/libtododb/Config.in
```kconfig
config BR2_PACKAGE_LIBTODODB
	bool "libtododb"
	depends on BR2_PACKAGE_LIBGTK2
	select BR2_PACKAGE_LIBGPEPIMC
	select BR2_PACKAGE_SQLITE2
	help
	  The GPE to-do item database library: the sqlite-backed store
	  (~/.gpe/todo.db) shared by gpe-todo and the GPE PIM sync tools.

	  Required by gpe-todo.

	  http://gpe.linuxtogo.org/ (defunct; sourced from the Debian archive)
```

## br2-external/package/sqlite2/Config.in
```kconfig
config BR2_PACKAGE_SQLITE2
	bool "sqlite2 (legacy)"
	select BR2_PACKAGE_READLINE
	select BR2_PACKAGE_NCURSES
	help
	  SQLite 2.8.17 - the last SQLite 2.x release (2005).

	  This is NOT a replacement for the "sqlite" package (which is
	  SQLite 3): the two are on-disk- and API-incompatible and install
	  side by side (libsqlite.so.0 + sqlite.pc vs libsqlite3.so.0 +
	  sqlite3.pc), so both can be enabled at once.

	  It exists here only because the GPE PIM stack (libgpepimc,
	  libtododb, gpe-sketchbook) is hard-wired to the sqlite 2 C API
	  (sqlite_open/sqlite_exec_printf/...), which was removed in
	  SQLite 3. Do not use it for anything new - it is unmaintained
	  and has no upstream security support.

	  https://www.sqlite.org/
```
